## CMakeLists.txt
```
# SPDX-License-Identifier: Apache-2.0

cmake_minimum_required(VERSION 3.13.1)

find_package(Zephyr REQUIRED HINTS $ENV{ZEPHYR_BASE})
project(ncp)

target_sources( app
    PRIVATE
        src/main.c
        src/netif_uartmux/netif_uartmux.c
)

include(${ZEPHYR_BASE}/samples/net/common/common.cmake)

set(gen_dir ${ZEPHYR_BINARY_DIR}/include/generated/)
```

## prj.conf
```kconfig
CONFIG_NETWORKING=y
CONFIG_NET_L2_DUMMY=y
CONFIG_NET_SHELL=y

CONFIG_GSM_MUX=y
CONFIG_GSM_MUX_INITIATOR=n
CONFIG_GSM_MUX_MRU_DEFAULT_LEN=128
CONFIG_GSM_MUX_MRU_MAX_LEN=512
CONFIG_UART_MUX=y
CONFIG_UART_MUX_RX_STACK_SIZE=1024
CONFIG_RING_BUFFER=y # Missing dependency of UART_MUX


# Disable certain parts of Zephyr IPv6 stack
CONFIG_NET_IPV6_NBR_CACHE=n
CONFIG_NET_IPV6_MLD=n

# Logging
#CONFIG_LOG=y
#CONFIG_LOG_PROCESS_THREAD_STACK_SIZE=2048
#CONFIG_LOG_BUFFER_SIZE=4096
#CONFIG_LOG_BACKEND_RTT=n
#CONFIG_GSM_MUX_LOG_LEVEL_DBG=y

#CONFIG_LOG_MAX_LEVEL=1
#CONFIG_LOG_MODE_MINIMAL=n
#CONFIG_LOG_BACKEND_SPINEL=y
#CONFIG_LOG_BACKEND_RTT=y
#CONFIG_LOG_BACKEND_UART=n
#CONFIG_BOOT_BANNER=n

# Kernel options
CONFIG_MAIN_STACK_SIZE=2048
CONFIG_INIT_STACKS=y

# Add features required for NCP
#CONFIG_OPENTHREAD_DIAG=y
#CONFIG_OPENTHREAD_DHCP6_SERVER=y
#CONFIG_OPENTHREAD_COMMISSIONER=y
#CONFIG_OPENTHREAD_BORDER_AGENT=y
#CONFIG_OPENTHREAD_BORDER_ROUTER=y
#CONFIG_OPENTHREAD_UDP_FORWARD=y
#CONFIG_OPENTHREAD_ENABLE_SERVICE=y

# Move console to other UART to not interfere with NCP
#CONFIG_UART_CONSOLE_ON_DEV_NAME="UART_1"
```

## src/main.c
```c
/*
 * Copyright (c) 2021 Nordic Semicondcutor
 *
 * SPDX-License-Identifier: Apache-2.0
 */

#include <logging/log.h>
LOG_MODULE_REGISTER(ot_br, LOG_LEVEL_DBG);

#include <stdlib.h>

#include <zephyr.h>
#include <usb/usb_device.h>
#include <drivers/uart.h>

#include <net/net_core.h>
#include <net/net_if.h>
#include <net/net_pkt.h>

void main(void)
{
    printk("Hello, starting\n");
    printk("Is it working?\n");
}
```
